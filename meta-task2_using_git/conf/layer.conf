## meta-task2_using_git/conf/layer.conf
```bitbake
# We have a conf and classes directory, add to BBPATH
BBPATH .= ":${LAYERDIR}"

# We have recipes-* directories, add to BBFILES
BBFILES += "${LAYERDIR}/recipes-*/*/*.bb \
            ${LAYERDIR}/recipes-*/*/*.bbappend"

BBFILE_COLLECTIONS += "meta-training4"
BBFILE_PATTERN_meta-training4 = "^${LAYERDIR}/"
BBFILE_PRIORITY_meta-training4 = "6"

LAYERDEPENDS_meta-training4 = "core"
LAYERSERIES_COMPAT_meta-training4 = "warrior zeus"
```
